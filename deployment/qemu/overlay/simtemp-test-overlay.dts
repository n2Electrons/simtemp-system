/dts-v1/;
/plugin/;

/* SimTemp Device Tree Overlay for F-K1-TC-002 Testing */

/ {
    compatible = "fsl,imx6ul-simtemp", "fsl,imx6ul";
    
    fragment@0 {
        target-path = "/soc/aips-bus@02000000/i2c@021a0000";
        __overlay__ {
            simtemp_overlay_test: temperature-sensor-overlay@49 {
                compatible = "simtemp,temperature-sensor-overlay";
                reg = <0x49>;
                status = "okay";
                
                /* Overlay-specific properties for testing */
                overlay_version = "1.0";
                test_mode = "enabled";
                
                /* Additional temperature sensor features via overlay */
                calibration_offset = <0>;
                hysteresis = <2>;
                
                /* Overlay GPIO configuration */
                overlay_alert_gpios = <&gpio1 11 0>;
                
                /* Properties that F-K1-TC-002 will validate */
                dt_overlay_support = "true";
                kernel_overlay_api = "configfs";
                overlay_loading_method = "live";
            };
        };
    };
    
    fragment@1 {
        target-path = "/";
        __overlay__ {
            simtemp_overlay_info {
                compatible = "simtemp,overlay-info";
                overlay_name = "simtemp-test-overlay";
                overlay_description = "Test overlay for F-K1-TC-002 validation";
                overlay_api_version = "4.19+";
            };
        };
    };
};