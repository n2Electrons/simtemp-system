// SPDX-License-Identifier: GPL-2.0+
/*
 * NXP SimTemp Device Tree Overlay for F-K8-TC-003 Testing
 * 
 * Copyright (c) 2025 Jorge Rodriguez Moreno
 * 
 * This overlay adds a simulated temperature sensor device for testing
 * the nxp_simtemp driver on i.MX6 QEMU emulation environments.
 */

/dts-v1/;
/plugin/;

/ {
    compatible = "fsl,imx6ul-evk", "fsl,imx6ul";
    
    fragment@0 {
        target-path = "/";
        __overlay__ {
            simtemp_device: simtemp {
                compatible = "nxp,simtemp";
                sampling_ms = <500>;
                threshold_mC = <25000>;
                mode = "continuous";
                status = "okay";
            };
        };
    };
};